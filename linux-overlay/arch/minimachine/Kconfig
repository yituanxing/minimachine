## linux-overlay/arch/minimachine/Kconfig
```kconfig
# SPDX-License-Identifier: GPL-2.0-only

config 64BIT
	def_bool y

config MINIMACHINE
	def_bool y
	select ARCH_HAS_BINFMT_FLAT
	select HAVE_UID16
	select GENERIC_IRQ_SHOW
	select THREAD_INFO_IN_TASK
	select UACCESS_MEMCPY

config MMU
	bool "MMU-based paged memory management"
	default n
	help
	  The first MiniMachine Linux milestone is deliberately NOMMU.
	  Paged virtual memory is a later architecture milestone.

config SMP
	bool "Symmetric multiprocessing"
	default n
	help
	  The first MiniMachine Linux milestone is deliberately uniprocessor.

config NR_CPUS
	int
	default 1

config GENERIC_HWEIGHT
	def_bool y

config GENERIC_CSUM
	def_bool y

source "kernel/Kconfig.hz"

menu "MiniMachine platform"

config CMDLINE
	string "Built-in kernel command line"
	default "console=ttyMM0"

endmenu
```

## linux-overlay/arch/minimachine/configs/defconfig
```kconfig
CONFIG_EXPERT=y
CONFIG_BINFMT_FLAT=y
CONFIG_BLK_DEV_INITRD=y
CONFIG_PRINTK=y
# CONFIG_MMU is not set
# CONFIG_SMP is not set
```
